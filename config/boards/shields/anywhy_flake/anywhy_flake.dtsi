#include "anywhy_flake_common.dtsi"

/ {
    kscan0: kscan0 {
        compatible = "zmk,kscan-gpio-matrix";
        diode-direction = "col2row";
        wakeup-source;
    };

    chosen {
        zmk,kscan = &kscan0;
        zmk,matrix-transform = &large_transform;
    };
 };