## config/boards/shields/klor_dongle/Kconfig.defconfig
```kconfig
if SHIELD_KLOR_DONGLE_CENTRAL

config ZMK_KEYBOARD_NAME
    default "KLOR"
    
config ZMK_SPLIT_ROLE_CENTRAL
    default y

config ZMK_USB
    default y

endif

if SHIELD_KLOR_DONGLE_LEFT || SHIELD_KLOR_DONGLE_RIGHT || SHIELD_KLOR_DONGLE_CENTRAL

config ZMK_SPLIT
    default y

config ZMK_BLE
    default y

endif
```

## config/boards/shields/klor_dongle/Kconfig.shield
```kconfig
config SHIELD_KLOR_DONGLE_LEFT
    def_bool $(shields_list_contains,klor_dongle_left)

config SHIELD_KLOR_DONGLE_RIGHT
    def_bool $(shields_list_contains,klor_dongle_right)

config SHIELD_KLOR_DONGLE_CENTRAL
    def_bool $(shields_list_contains,klor_dongle_central)
```
