## config/boards/shields/anywhy_flake/Kconfig.shield
```kconfig
config SHIELD_ANYWHY_FLAKE_LEFT
    def_bool $(shields_list_contains,anywhy_flake_left)
    select ZMK_SPLIT
    select SHIELD_ANYWHY_FLAKE

config SHIELD_ANYWHY_FLAKE_RIGHT
    def_bool $(shields_list_contains,anywhy_flake_right)
    select ZMK_SPLIT
    select SHIELD_ANYWHY_FLAKE

config SHIELD_ANYWHY_FLAKE_DONGLE
    def_bool $(shields_list_contains,anywhy_flake_dongle)
    select ZMK_SPLIT_ROLE_CENTRAL
    select ZMK_SPLIT
    select SHIELD_ANYWHY_FLAKE
```

## config/boards/shields/go60/Kconfig.defconfig
```kconfig
if SHIELD_GO60_DONGLE

config ZMK_KEYBOARD_NAME
    default "Go60"

config ZMK_SPLIT_ROLE_CENTRAL
    default y

config ZMK_SPLIT
    default y

config ZMK_POINTING
    default y

config ZMK_SPLIT_BLE_CENTRAL_PERIPHERALS
    default 2

endif
```

## config/boards/shields/peppakbd/Kconfig.defconfig
```kconfig
if SHIELD_PEPPAKBD_DONGLE

config ZMK_KEYBOARD_NAME
    default "peppakbd"

config ZMK_SPLIT_ROLE_CENTRAL
    default y

endif

if SHIELD_PEPPAKBD_DONGLE || SHIELD_PEPPAKBD_LEFT || SHIELD_PEPPAKBD_RIGHT

config ZMK_SPLIT
    default y

endif
```

## config/boards/shields/peppakbd/Kconfig.shield
```kconfig
config SHIELD_PEPPAKBD_LEFT
    def_bool $(shields_list_contains,peppakbd_left)
    select ZMK_SPLIT
    select SHIELD_PEPPAKBD

config SHIELD_PEPPAKBD_RIGHT
    def_bool $(shields_list_contains,peppakbd_right)
    select ZMK_SPLIT
    select SHIELD_PEPPAKBD

config SHIELD_PEPPAKBD_DONGLE
    def_bool $(shields_list_contains,peppakbd_dongle)
    select ZMK_SPLIT_ROLE_CENTRAL
    select ZMK_SPLIT
    select SHIELD_PEPPAKBD
```

## config/boards/shields/totem_custom/Kconfig.defconfig
```kconfig
if SHIELD_TOTEM_CUSTOM_DONGLE

config ZMK_KEYBOARD_NAME
    default "Totem"

config ZMK_SPLIT_ROLE_CENTRAL
    default y

endif

if SHIELD_TOTEM_CUSTOM_DONGLE || SHIELD_TOTEM_CUSTOM_LEFT || SHIELD_TOTEM_CUSTOM_RIGHT

config ZMK_SPLIT
    default y

endif
```

## config/boards/shields/totem_custom/Kconfig.shield
```kconfig
config SHIELD_TOTEM_CUSTOM_LEFT
    def_bool $(shields_list_contains,totem_custom_left)
    select ZMK_SPLIT
    select SHIELD_TOTEM_CUSTOM

config SHIELD_TOTEM_CUSTOM_RIGHT
    def_bool $(shields_list_contains,totem_custom_right)
    select ZMK_SPLIT
    select SHIELD_TOTEM_CUSTOM

config SHIELD_TOTEM_CUSTOM_DONGLE
    def_bool $(shields_list_contains,totem_custom_dongle)
    select ZMK_SPLIT_ROLE_CENTRAL
    select ZMK_SPLIT
    select SHIELD_TOTEM_CUSTOM
```

## config/boards/shields/totem_dongle/Kconfig.defconfig
```kconfig
if SHIELD_TOTEM_DONGLE_CENTRAL

config ZMK_KEYBOARD_NAME
    default "TOTEM"
    
config ZMK_SPLIT_ROLE_CENTRAL
    default y

config ZMK_USB
    default y

endif

if SHIELD_TOTEM_DONGLE_LEFT || SHIELD_TOTEM_DONGLE_RIGHT || SHIELD_TOTEM_DONGLE_CENTRAL

config ZMK_SPLIT
    default y

config ZMK_BLE
    default y

endif
```

## config/boards/shields/totem_dongle/Kconfig.shield
```kconfig
config SHIELD_TOTEM_DONGLE_LEFT
    def_bool $(shields_list_contains,totem_dongle_left)

config SHIELD_TOTEM_DONGLE_RIGHT
    def_bool $(shields_list_contains,totem_dongle_right)

config SHIELD_TOTEM_DONGLE_CENTRAL
    def_bool $(shields_list_contains,totem_dongle_central)
```
